## esp32-demo/main/Kconfig.projbuild
```kconfig
menu "DSOTRON-CSI Configuration"

config DSOTRON_WIFI_SSID
    string "WiFi SSID"
    default "myssid"
    help
        SSID of the WiFi network to connect to.

config DSOTRON_WIFI_PASS
    string "WiFi Password"
    default "mypassword"
    help
        Password for the WiFi network.

endmenu
```
